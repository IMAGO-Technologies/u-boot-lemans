## board/imago/visionbox_lemans/Kconfig
```kconfig
if TARGET_VISIONBOX_LEMANS

config SYS_BOARD
	default "visionbox_lemans"

config SYS_VENDOR
	default "imago"

config SYS_SOC
	default "fsl-layerscape"

config SYS_CONFIG_NAME
	default "visionbox_lemans"

endif
```

## configs/visionbox-lemans_defconfig
```kconfig
CONFIG_ARM=y
CONFIG_TARGET_VISIONBOX_LEMANS=y
CONFIG_DEFAULT_DEVICE_TREE="fsl-ls2088a-lemans"
CONFIG_SYS_EXTRA_OPTIONS="SYS_FSL_DDR4, QSPI_BOOT, LS2080A"
CONFIG_OF_CONTROL=y
CONFIG_NET_RANDOM_ETHADDR=y
CONFIG_DM=y
CONFIG_NETDEVICES=y
CONFIG_E1000=y
CONFIG_DM_SPI=y
CONFIG_DM_SPI_FLASH=y
CONFIG_SYS_NS16550=y
CONFIG_FSL_QSPI=y
```
